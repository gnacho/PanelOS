## buildroot/Config.in
```kconfig
# Packages of this external tree.
source "$BR2_EXTERNAL_NSPANEL_PATH/package/panelos-web/Config.in"
source "$BR2_EXTERNAL_NSPANEL_PATH/package/noto-sans/Config.in"
```

## buildroot/package/noto-sans/Config.in
```kconfig
config BR2_PACKAGE_NOTO_SANS
	bool "noto-sans"
	help
	  Noto Sans (variable, Latin / Greek / Cyrillic) from Google Fonts,
	  for the web view: a wide fallback next to DejaVu Sans, e.g. for
	  punctuation that cards use (U+2E31 word separator middle dot).

	  https://fonts.google.com/noto/specimen/Noto+Sans
```

## buildroot/package/panelos-web/Config.in
```kconfig
config BR2_PACKAGE_PANELOS_WEB
	bool "panelos-web"
	depends on BR2_PACKAGE_WPEWEBKIT
	depends on BR2_PACKAGE_MESA3D_GBM
	help
	  The Home Assistant frontend in WPE WebKit for the PanelOS
	  panel app: renders off screen on the GPU and hands every
	  frame to the app through shared memory.
```
